## drivers/net/wireless/bcmdhd89/Kconfig
```kconfig
config BCMDHD89
	tristate "Broadcom 4329/30 5.90.195.89wireless cards support"
	depends on MMC
	---help---
	  This module adds support for wireless adapters based on
	  Broadcom 4329/30 chipset.

	  This driver uses the kernel's wireless extensions subsystem.

	  If you choose to build a module, it'll be called dhd. Say M if
	  unsure.

config BCMDHD_FW_PATH
	depends on BCMDHD89
	string "Firmware path"
	default "/system/etc/wifi/fw_bcmdhd.bin"
	---help---
	  Path to the firmware file.

config BCMDHD_NVRAM_PATH
	depends on BCMDHD89
	string "NVRAM path"
	default "/system/etc/wifi/bcmdhd.cal"
	---help---
	  Path to the calibration file.

config BCMDHD_WEXT
	bool "Enable WEXT support"
	depends on BCMDHD89 && CFG80211 = n
	select WIRELESS_EXT
	select WEXT_PRIV
	help
	  Enables WEXT support

config DHD_USE_SCHED_SCAN
	bool "Use CFG80211 sched scan"
	depends on BCMDHD89 && CFG80211
	default y
	---help---
	  Use CFG80211 sched scan
config WLAN_SDIO
	bool "Enable SDIO interface for BCMDHD"
	depends on BCMDHD89
	default n
	---help---
	  Use memory preallocated in platform
```

## drivers/net/wireless/rtl8723as/Kconfig
```kconfig
config RTL8723AS
	tristate "Realtek 8723A SDIO or SPI WiFi"
	---help---
	  Help message of RTL8723AS

config WLAN_SDIO
	bool "Enable SDIO interface for Realtek"
	depends on RTL8723AS
	default n
	---help---
	  Use memory preallocated in platform
```

## sound/soc/sprd/codec/null-codec/Kconfig
```kconfig
config SND_SOC_NULL_CODEC
	tristate # "null codec"
	help
	 "just for the audio codec code"
```
